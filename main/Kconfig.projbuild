## main/Kconfig.projbuild
```kconfig
menu "Example Bridge Configuration"
    config EXAMPLE_BR_DHCPS
        bool "Enable DHCP Server"
        default n
        help
            Enable DHCP Server on the device.
endmenu
menu "Bridge mode Configuration"

config EXAMPLE_BR_MODE
    string "Select Bridge Mode"
    default "STA"
    help
        Choose the mode for the bridge. Options are:
        - STA: Station mode
        - AP: Access Point mode

choice
    prompt "Bridge Mode"

config EXAMPLE_BR_MODE_STA
    bool "Station Mode (STA)"
    help
        Configure the bridge to operate in Station mode.

config EXAMPLE_BR_MODE_AP
    bool "Access Point Mode (AP)"
    help
        Configure the bridge to operate in Access Point mode.
endchoice
endmenu
menu "Example AP Wifi Configuration"
    config EXAMPLE_BR_WIFI
        depends on SOC_WIFI_SUPPORTED
        default n
        bool "Bridge WiFi interface"
        help
            Add WiFi interface to be bridged.

    config EXAMPLE_BR_WIFI_SSID
        depends on EXAMPLE_BR_WIFI
        string "WiFi SSID"
        default "myssid"
        help
            SSID (network name) for the example to connect to.

    config EXAMPLE_BR_WIFI_PASSWORD
        depends on EXAMPLE_BR_WIFI
        string "WiFi Password"
        default "mypassword"
        help
            WiFi password (WPA or WPA2) for the example to use.

    config EXAMPLE_BR_WIFI_CHANNEL
        depends on EXAMPLE_BR_WIFI
        int "WiFi Channel"
        range 1 13
        default 1
        help
            WiFi channel (network channel) for the example to use.

    config EXAMPLE_BR_MAX_STA_CONN
        depends on EXAMPLE_BR_WIFI
        int "Maximal STA connections"
        default 4
        help
            Max number of the STA connects to AP.
endmenu

menu "HTTP Server"

config HTTPD_MAX_REQ_HDR_LEN
    int "Max HTTP Request Header Length"
    default 512
    help
        This sets the maximum supported size of headers section in HTTP request packet to be processed by the server

config HTTPD_MAX_URI_LEN
    int "Max HTTP URI Length"
    default 512
    help
        This sets the maximum supported size of HTTP request URI to be processed by the server

endmenu
```
